## CMakeLists.txt
```
#
# Zephyr Shell Browser Console example application
#

cmake_minimum_required( VERSION 3.13.1)

set(BOARD qemu_x86)

# we add our own module to the build
list(APPEND ZEPHYR_EXTRA_MODULES
  ${CMAKE_CURRENT_SOURCE_DIR}/..
  )

find_package( Zephyr REQUIRED HINTS $ENV{ZEPHYR_BASE})

project( app LANGUAGES C VERSION 1.0.0)
  
configure_file( app_version.h.in ${CMAKE_BINARY_DIR}/app/include/app_version.h)

target_include_directories( app PRIVATE ${CMAKE_BINARY_DIR}/app/include src)
target_include_directories( app PRIVATE ${CMAKE_BINARY_DIR}/include src)
target_sources( app PRIVATE src/main.c)
```

## Kconfig
```
# This file is the application Kconfig entry point. All application Kconfig
# options can be defined here or included via other application Kconfig files.
# You can browse these options using the west targets menuconfig (terminal) or
# guiconfig (GUI).

menu "Zephyr"
source "Kconfig.zephyr"
endmenu

rsource "../Kconfig"

module = APP
module-str = APP
# source "subsys/logging/Kconfig.template.log_config"
```

## prj.conf
```kconfig
# CONFIG_DEBUG=y

CONFIG_SHELL_BROWSER=y


CONFIG_CONSOLE_SUBSYS=y
CONFIG_CONSOLE_GETCHAR=y

CONFIG_RING_BUFFER=y
#CONFIG_EVENTS=y

CONFIG_SHELL=y
CONFIG_SHELL_BACKENDS=n
CONFIG_SHELL_BACKEND_SERIAL=n
CONFIG_SHELL_AUTOSTART=y
CONFIG_KERNEL_SHELL=n
CONFIG_DEVICE_SHELL=n
CONFIG_DEVMEM_SHELL=n
```

## src/main.c
```c
#include <zephyr/kernel.h>
#include <zephyr/sys/printk.h>
#include <zephyr/console/console.h>
#include <shell_browser/shell_browser_console.h>
#include "app_version.h"

#ifdef CONFIG_SHELL_BROWSER

SHELL_BROWSER_CONSOLE_DEFINE( sbc, "$", 128, 128, 1024 );

#endif

void main(void)
{
  console_init();
  shell_browser_console_init( &sbc);

  printk("Zephyr Shell Browser Example Application %s\n", APP_VERSION_STR);
  printk("----------\n");
  printk("Button '1' - cycle through alternative commands / arguments\n");
  printk("Button '2' - choose current command / argument\n");
  printk("Button '3' - execute command\n");
  printk("use only this buttons if in browser mode\n");
  printk("----------\n");
  printk("Button '4' - browser mode (default) - parse shell result\n");
  printk("Button '5' - shell mode - print shell output\n");
  printk("You can use all keys except '1'-'5' if in shell mode\n"); 
  
  char c = '\0';
  while ( 1) {
    c = console_getchar();
    shell_browser_console_putc( &sbc, c);
  }
}
```
